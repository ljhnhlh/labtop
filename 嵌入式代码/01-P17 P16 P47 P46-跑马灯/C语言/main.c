/*---------------------------------------------------------------------*/
/* --- STC MCU International Limited ----------------------------------*/
/* --- STC 1T Series MCU Demo Programme -------------------------------*/
/* --- Mobile: (86)13922805190 ----------------------------------------*/
/* --- Fax: 86-0513-55012956,55012947,55012969 ------------------------*/
/* --- Tel: 86-0513-55012928,55012929,55012966 ------------------------*/
/* --- Web: www.GXWMCU.com --------------------------------------------*/
/* --- QQ:  800003751 -------------------------------------------------*/
/* 如果要在程序中使用此代码,请在程序中注明使用了宏晶科技的资料及程序   */
/*---------------------------------------------------------------------*/

#define 	MAIN_Fosc		22118400L	//定义主时钟

#include	"STC15Fxxxx.H"

/*************	功能说明	**************

程序使用P4.7 P4.6 P1.6 P1.7 来演示跑马灯，输出低驱动。

******************************************/

void  inter(int n);
unsigned char i;
unsigned char b;

/******************** 主函数 **************************/
void main(void)
{
	P0M1 = 0;	P0M0 = 0;	//设置为准双向口
	P1M1 = 0;	P1M0 = 0;	//设置为准双向口
	P2M1 = 0;	P2M0 = 0;	//设置为准双向口
	P3M1 = 0;	P3M0 = 0;	//设置为准双向口
	P4M1 = 0;	P4M0 = 0;	//设置为准双向口
	P5M1 = 0;	P5M0 = 0;	//设置为准双向口
	P6M1 = 0;	P6M0 = 0;	//设置为准双向口
	P7M1 = 0;	P7M0 = 0;	//设置为准双向口

	b = 0;
	TMOD=0x01;
	TL0 = 0x58;
	TH0 = 0x9E;
	i = 10;
	ET0 = 1;
	EA = 1;
	TR0 = 1;
	while(1);
}

//========================================================================
// 函数: void  delay_ms(u8 ms)
// 描述: 延时函数。
// 参数: ms,要延时的ms数, 这里只支持1~255ms. 自动适应主时钟.
// 返回: none.
// 版本: VER1.0
// 日期: 2013-4-1
// 备注: 
//========================================================================
void inter()
{
	
}
void T0_ISR(void)interrupt 1
{
	TL0 = 0x58;
	TH0 = 0x9E;
	i--;
	if(i==0)
	{
		b++;
		
		unsigned char t = b%9;
		if(b == 9)
			b = 0;
		if(t == 1)
		P17 = 0;
		else if(t == 3){
		P17 = 1;
		P16 = 0;
		}
		else if(t == 5){
		P16 = 1;
		P47 = 0;}
		else if(t == 7){
		P47 = 1;
		P46 = 0;}
		else if(t == 9){
		P46 = 1;}

		i = 10;
	}
}

